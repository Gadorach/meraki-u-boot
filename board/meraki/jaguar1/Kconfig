## board/meraki/jaguar1/Kconfig
```kconfig
# SPDX-License-Identifier: (GPL-2.0+ OR MIT)

if SOC_JAGUAR1

config SYS_VENDOR
	default "meraki"

config SYS_BOARD
	default "jaguar1"

choice
	prompt "Cisco Meraki Jaguar1 board"
	default TARGET_MERAKI_MS42P
	help
	  Select the board topology explicitly; secondary-ASIC detection is not
	  reliable enough to identify a model during cold boot.

config TARGET_MERAKI_MS42P
	bool "MS42/MS42P"
	help
	  Build for the MS42 or MS42P using the shared polled Ethernet path on
	  master-Jaguar physical port 2.

config TARGET_MERAKI_MS220_48
	bool "MS220-48 family"
	help
	  Build for an MS220-48-family switch with a secondary Jaguar1 ASIC and
	  the shared master-Jaguar physical-port-2 Ethernet path.

config TARGET_MERAKI_MS320_24
	bool "MS320-24 family"
	help
	  Build for a single-ASIC MS320-24-family switch with the shared
	  master-Jaguar physical-port-2 Ethernet path.

config TARGET_MERAKI_MS320_48
	bool "MS320-48 family"
	help
	  Build for an MS320-48-family switch with a secondary Jaguar1 ASIC and
	  the shared master-Jaguar physical-port-2 Ethernet path.

endchoice

config MERAKI_JAGUAR1_DUAL
	bool
	default y if TARGET_MERAKI_MS42P || TARGET_MERAKI_MS220_48 || TARGET_MERAKI_MS320_48

config MERAKI_JAGUAR1_MODEL
	string
	default "MS42/MS42P" if TARGET_MERAKI_MS42P
	default "MS220-48" if TARGET_MERAKI_MS220_48
	default "MS320-24" if TARGET_MERAKI_MS320_24
	default "MS320-48" if TARGET_MERAKI_MS320_48

config MERAKI_JAGUAR1_BOARD_ID
	hex
	default 0x00000001 if TARGET_MERAKI_MS42P
	default 0x00000002 if TARGET_MERAKI_MS220_48
	default 0x00000003 if TARGET_MERAKI_MS320_24
	default 0x00000004 if TARGET_MERAKI_MS320_48
	help
	  Stable board identifier embedded in and validated against each stage2
	  slot header. This prevents a valid image for another Jaguar1 platform
	  from being selected.

config MERAKI_JAGUAR1_RESET_BUTTON_GPIO
	int
	default 13 if TARGET_MERAKI_MS42P
	default -1
	help
	  Primary Jaguar1 GPIO connected to the active-low reset button. Leave this
	  at -1 when the platform assignment has not been confirmed.

config MERAKI_JAGUAR1_EARLY_SWITCH_INIT
	bool "Initialize the secondary switch ASIC before the U-Boot prompt"
	help
	  Probe the secondary ASIC over PI and initialize its SGPIO controller
	  during board_early_init_r(). Local GPIO, PHY fan control, and SGPIO are
	  initialized regardless so cooling and safe LED defaults are established.
	  Leave this disabled until the secondary-ASIC path is proven.

choice
	prompt "Jaguar1 boot stage"
	default MERAKI_JAGUAR1_STAGE1

config MERAKI_JAGUAR1_STAGE1
	bool "Build the NOR-resident stage1"
	help
	  Build the minimal reset image which initializes DDR, validates both
	  redundant stage2 slots, and loads the newest valid generation.

config MERAKI_JAGUAR1_STAGE2
	bool "Build the DDR-resident full U-Boot stage2"
	select MIPS_MACH_EARLY_INIT
	select SKIP_LOWLEVEL_INIT
	help
	  Build a full U-Boot image which stage1 loads into initialized DDR. Stage2
	  owns networking, persistent environment, verified Linux boot, and storage
	  policy. It must not be written into the 256 KiB reset-vector partition.

endchoice

config MERAKI_MS42P_NAND
	bool
	default y if TARGET_MERAKI_MS42P && MERAKI_JAGUAR1_STAGE2
	select BCH
	select MTD
	select MTD_PARTITIONS
	select MTD_RAW_NAND
	select NAND_ECC_BCH
	select SYS_NAND_SELF_INIT
	help
	  Enable the MS42/MS42P Micron parallel NAND on Jaguar1 PI chip select 1.
	  NAND is deliberately absent from stage1 and the other Jaguar1 targets.

endif
```

## board/mscc/ocelot/Kconfig
```kconfig
# SPDX-License-Identifier: (GPL-2.0+ OR MIT)

if SOC_OCELOT

config SYS_VENDOR
	default "mscc"

config SYS_BOARD
	default "ocelot"

config SYS_CONFIG_NAME
	default "ocelot"

endif
```

## configs/meraki_ms320_48_jaguar1_defconfig
```kconfig
CONFIG_MIPS=y
CONFIG_TEXT_BASE=0x40000000
CONFIG_DEFAULT_DEVICE_TREE="meraki_ms320_48"
CONFIG_SYS_BOOTM_LEN=0x2000000
CONFIG_SYS_LOAD_ADDR=0x81000000
CONFIG_DEBUG_UART_BASE=0x70100000
CONFIG_DEBUG_UART_CLOCK=208333333
CONFIG_DEBUG_UART_BOARD_INIT=y
CONFIG_ARCH_MSCC=y
CONFIG_SOC_JAGUAR1=y
CONFIG_TARGET_MERAKI_MS320_48=y
CONFIG_MERAKI_JAGUAR1_STAGE1=y
CONFIG_DDRTYPE_MT47H64M16=y
CONFIG_SYS_MIPS_TIMER_FREQ=208333333
CONFIG_MIPS_RELOCATION_TABLE_SIZE=0x3200
CONFIG_DEBUG_UART=y
CONFIG_SYS_LITTLE_ENDIAN=y
CONFIG_HAS_BOARD_SIZE_LIMIT=y
CONFIG_BOARD_SIZE_LIMIT=262144
CONFIG_SYS_CBSIZE=256
CONFIG_SYS_PBSIZE=281
CONFIG_LOGLEVEL=4
CONFIG_BOARD_EARLY_INIT_R=y
CONFIG_BOARD_LATE_INIT=y
# CONFIG_DISPLAY_CPUINFO is not set
# CONFIG_DISPLAY_BOARDINFO is not set
# CONFIG_AUTOBOOT is not set
# CONFIG_AUTO_COMPLETE is not set
# CONFIG_SYS_LONGHELP is not set
CONFIG_SYS_PROMPT="ms320-48-stage1 # "
CONFIG_SYS_MAXARGS=8
# CONFIG_SYS_XTRACE is not set
# CONFIG_CMD_CONSOLE is not set
# CONFIG_CMD_BOOTM is not set
# CONFIG_CMD_ELF is not set
# CONFIG_CMD_FDT is not set
CONFIG_CMD_GO=y
# CONFIG_CMD_IMI is not set
# CONFIG_CMD_XIMG is not set
# CONFIG_CMD_EXPORTENV is not set
# CONFIG_CMD_IMPORTENV is not set
# CONFIG_CMD_EDITENV is not set
# CONFIG_CMD_SAVEENV is not set
# CONFIG_CMD_ENV_EXISTS is not set
# CONFIG_CMD_CRC32 is not set
# CONFIG_CMD_MD5SUM is not set
# CONFIG_CMD_MEMINFO is not set
# CONFIG_CMD_RANDOM is not set
CONFIG_CMD_LOADB=y
# CONFIG_CMD_LOADS is not set
# CONFIG_CMD_ITEST is not set
# CONFIG_CMD_SOURCE is not set
# CONFIG_CMD_SETEXPR is not set
# CONFIG_CMD_SLEEP is not set
# CONFIG_CMD_RUN is not set
# CONFIG_CMD_MEMORY is not set
# CONFIG_CMD_SF is not set
# CONFIG_CMD_ECHO is not set
# CONFIG_ISO_PARTITION is not set
CONFIG_CLK=y
# CONFIG_NET is not set
# CONFIG_MTD is not set
CONFIG_SPECIFY_CONSOLE_INDEX=y
CONFIG_DM_SERIAL=y
CONFIG_DEBUG_UART_SHIFT=2
CONFIG_SYS_NS16550=y
# CONFIG_SPI is not set
```

## configs/meraki_ms320_48_jaguar1_stage2_defconfig
```kconfig
CONFIG_MIPS=y
CONFIG_TEXT_BASE=0x81000000
CONFIG_DEFAULT_DEVICE_TREE="meraki_ms320_48"
CONFIG_SYS_BOOTM_LEN=0x2000000
CONFIG_SYS_LOAD_ADDR=0x82000000
CONFIG_DEBUG_UART_BASE=0x70100000
CONFIG_DEBUG_UART_CLOCK=208333333
CONFIG_DEBUG_UART_BOARD_INIT=y
CONFIG_ARCH_MSCC=y
CONFIG_SOC_JAGUAR1=y
CONFIG_TARGET_MERAKI_MS320_48=y
# CONFIG_MERAKI_JAGUAR1_EARLY_SWITCH_INIT is not set
CONFIG_MERAKI_JAGUAR1_STAGE2=y
CONFIG_DDRTYPE_MT47H64M16=y
CONFIG_SKIP_LOWLEVEL_INIT=y
CONFIG_SYS_MIPS_TIMER_FREQ=208333333
CONFIG_MIPS_RELOCATION_TABLE_SIZE=0x4000
CONFIG_MIPS_BOOT_FDT=y
CONFIG_DEBUG_UART=y
CONFIG_SYS_MEMTEST_START=0x80000000
CONFIG_SYS_MEMTEST_END=0x86000000
CONFIG_SYS_LITTLE_ENDIAN=y
CONFIG_FIT=y
# CONFIG_FIT_PRINT is not set
CONFIG_SHA256=y
CONFIG_BOOTDELAY=3
CONFIG_USE_BOOTARGS=y
CONFIG_BOOTARGS="console=ttyS0,115200"
CONFIG_USE_BOOTCOMMAND=y
CONFIG_BOOTCOMMAND="if test ${recovery_requested} = 1; then echo NOR recovery requested; run nor_recovery; else run nand_boot || run nor_recovery; fi"
CONFIG_HUSH_PARSER=y
CONFIG_SYS_CBSIZE=512
CONFIG_SYS_PBSIZE=537
CONFIG_LOGLEVEL=7
CONFIG_DISPLAY_CPUINFO=y
CONFIG_BOARD_EARLY_INIT_R=y
CONFIG_BOARD_LATE_INIT=y
# CONFIG_AUTO_COMPLETE is not set
CONFIG_SYS_PROMPT="ms320-48-stage2 # "
CONFIG_SYS_MAXARGS=24
# CONFIG_SYS_XTRACE is not set
# CONFIG_CMD_CONSOLE is not set
# CONFIG_BOOTM_PLAN9 is not set
# CONFIG_BOOTM_RTEMS is not set
# CONFIG_BOOTM_VXWORKS is not set
# CONFIG_CMD_ELF is not set
CONFIG_CMD_FDT=y
# CONFIG_CMD_GO is not set
CONFIG_CMD_IMI=y
# CONFIG_CMD_XIMG is not set
CONFIG_CMD_EXPORTENV=y
CONFIG_CMD_IMPORTENV=y
CONFIG_CMD_EDITENV=y
CONFIG_CMD_SAVEENV=y
CONFIG_CMD_ENV_EXISTS=y
CONFIG_CMD_MD5SUM=y
CONFIG_CMD_HASH=y
CONFIG_CMD_MEMINFO=y
# CONFIG_CMD_RANDOM is not set
CONFIG_CMD_MEMTEST=y
# CONFIG_CMD_LOADS is not set
CONFIG_CMD_ITEST=y
CONFIG_CMD_SOURCE=y
CONFIG_CMD_SETEXPR=y
# CONFIG_BOOTP_BOOTPATH is not set
# CONFIG_BOOTP_DNS is not set
# CONFIG_BOOTP_HOSTNAME is not set
# CONFIG_NET_TFTP_VARS is not set
CONFIG_TFTP_BLOCKSIZE=512
CONFIG_CMD_DHCP=y
CONFIG_CMD_PING=y
CONFIG_CMD_SLEEP=y
# CONFIG_ISO_PARTITION is not set
CONFIG_NET_RANDOM_ETHADDR=y
CONFIG_CLK=y
CONFIG_MTD=y
CONFIG_DM_SPI_FLASH=y
CONFIG_SPI_FLASH_GIGADEVICE=y
CONFIG_SPI_FLASH_MACRONIX=y
CONFIG_SPI_FLASH_SPANSION=y
CONFIG_SPI_FLASH_STMICRO=y
CONFIG_SPI_FLASH_WINBOND=y
CONFIG_MERAKI_JAGUAR1_BOOTNET=y
CONFIG_SPECIFY_CONSOLE_INDEX=y
CONFIG_DM_SERIAL=y
CONFIG_DEBUG_UART_SHIFT=2
CONFIG_SYS_NS16550=y
CONFIG_SPI=y
CONFIG_DM_SPI=y
CONFIG_ENV_IS_IN_SPI_FLASH=y
CONFIG_ENV_REDUNDANT=y
CONFIG_ENV_OFFSET=0x1c0000
CONFIG_ENV_OFFSET_REDUND=0x1d0000
CONFIG_ENV_SIZE=0x10000
CONFIG_ENV_SECT_SIZE=0x10000
```

## configs/meraki_ms42p_jaguar1_defconfig
```kconfig
CONFIG_MIPS=y
CONFIG_TEXT_BASE=0x40000000
CONFIG_DEFAULT_DEVICE_TREE="meraki_ms42p"
CONFIG_SYS_BOOTM_LEN=0x2000000
CONFIG_SYS_LOAD_ADDR=0x81000000
CONFIG_DEBUG_UART_BASE=0x70100000
CONFIG_DEBUG_UART_CLOCK=208333333
CONFIG_DEBUG_UART_BOARD_INIT=y
CONFIG_ARCH_MSCC=y
CONFIG_SOC_JAGUAR1=y
CONFIG_MERAKI_JAGUAR1_EARLY_SWITCH_INIT=y
CONFIG_DDRTYPE_MT47H64M16=y
CONFIG_SYS_MIPS_TIMER_FREQ=208333333
CONFIG_MIPS_RELOCATION_TABLE_SIZE=0x3200
CONFIG_MIPS_BOOT_FDT=y
CONFIG_DEBUG_UART=y
CONFIG_SYS_MEMTEST_START=0x80000000
CONFIG_SYS_MEMTEST_END=0x87c00000
CONFIG_SYS_LITTLE_ENDIAN=y
CONFIG_HAS_BOARD_SIZE_LIMIT=y
CONFIG_BOARD_SIZE_LIMIT=262144
CONFIG_FIT=y
# CONFIG_FIT_PRINT is not set
CONFIG_BOOTDELAY=3
CONFIG_USE_BOOTARGS=y
CONFIG_BOOTARGS="console=ttyS0,115200"
CONFIG_USE_BOOTCOMMAND=y
CONFIG_BOOTCOMMAND="echo Automatic flash boot is disabled; echo Use: run netboot"
CONFIG_SYS_CBSIZE=256
CONFIG_SYS_PBSIZE=281
CONFIG_LOGLEVEL=7
CONFIG_DISPLAY_CPUINFO=y
CONFIG_BOARD_EARLY_INIT_R=y
CONFIG_BOARD_LATE_INIT=y
# CONFIG_AUTO_COMPLETE is not set
# CONFIG_SYS_LONGHELP is not set
CONFIG_SYS_PROMPT="ms42p # "
CONFIG_SYS_MAXARGS=16
# CONFIG_SYS_XTRACE is not set
# CONFIG_CMD_CONSOLE is not set
# CONFIG_BOOTM_PLAN9 is not set
# CONFIG_BOOTM_RTEMS is not set
# CONFIG_BOOTM_VXWORKS is not set
# CONFIG_CMD_ELF is not set
# CONFIG_CMD_FDT is not set
# CONFIG_CMD_GO is not set
# CONFIG_CMD_IMI is not set
# CONFIG_CMD_XIMG is not set
# CONFIG_CMD_EXPORTENV is not set
# CONFIG_CMD_IMPORTENV is not set
# CONFIG_CMD_EDITENV is not set
# CONFIG_CMD_SAVEENV is not set
# CONFIG_CMD_ENV_EXISTS is not set
CONFIG_CMD_MD5SUM=y
CONFIG_CMD_MEMINFO=y
# CONFIG_CMD_RANDOM is not set
CONFIG_CMD_MEMTEST=y
# CONFIG_CMD_LOADS is not set
# CONFIG_CMD_ITEST is not set
# CONFIG_CMD_SOURCE is not set
# CONFIG_CMD_SETEXPR is not set
# CONFIG_BOOTP_BOOTPATH is not set
# CONFIG_BOOTP_DNS is not set
# CONFIG_BOOTP_HOSTNAME is not set
# CONFIG_NET_TFTP_VARS is not set
CONFIG_TFTP_BLOCKSIZE=512
CONFIG_CMD_DHCP=y
CONFIG_CMD_PING=y
# CONFIG_CMD_SLEEP is not set
# CONFIG_ISO_PARTITION is not set
CONFIG_NET_RANDOM_ETHADDR=y
CONFIG_CLK=y
CONFIG_MTD=y
CONFIG_DM_SPI_FLASH=y
CONFIG_SPI_FLASH_GIGADEVICE=y
CONFIG_SPI_FLASH_MACRONIX=y
CONFIG_SPI_FLASH_SPANSION=y
CONFIG_SPI_FLASH_STMICRO=y
CONFIG_SPI_FLASH_WINBOND=y
CONFIG_MERAKI_JAGUAR1_BOOTNET=y
CONFIG_SPECIFY_CONSOLE_INDEX=y
CONFIG_DM_SERIAL=y
CONFIG_DEBUG_UART_SHIFT=2
CONFIG_SYS_NS16550=y
CONFIG_SPI=y
CONFIG_DM_SPI=y
# CONFIG_SHA256 is not set
```

## drivers/net/mscc_eswitch/Kconfig
```kconfig
# SPDX-License-Identifier: GPL-2.0+
#
# Copyright (c) 2019 Microsemi Corporation

config MSCC_OCELOT_SWITCH
	bool "Ocelot switch driver"
	depends on ARCH_MSCC
	select PHYLIB
	help
	  This driver supports the Ocelot network switch device.

config MSCC_LUTON_SWITCH
	bool "Luton switch driver"
	depends on ARCH_MSCC
	select PHYLIB
	help
	  This driver supports the Luton network switch device.

config MSCC_JR2_SWITCH
	bool "Jaguar2 switch driver"
	depends on ARCH_MSCC
	select PHYLIB
	help
	  This driver supports the Jaguar2 network switch device.

config MSCC_SERVALT_SWITCH
	bool "Servalt switch driver"
	depends on ARCH_MSCC
	select PHYLIB
	help
	  This driver supports the Servalt network switch device.

config MSCC_SERVAL_SWITCH
	bool "Serval switch driver"
	depends on ARCH_MSCC
	select PHYLIB
	help
	  This driver supports the Serval network switch device.

config MERAKI_JAGUAR1_BOOTNET
	bool "Meraki Jaguar1 boot Ethernet"
	depends on ARCH_MSCC && DM_ETH && OF_CONTROL
	help
	  Enable the shared, polled Ethernet path used by Meraki Jaguar1 boards.
	  It owns master-Jaguar physical port 2 and does not configure the slave
	  Jaguar, VStaX, or FDMA.

config MSCC_FELIX_SWITCH
	bool "Felix switch driver"
	depends on DM_DSA
	select FSL_ENETC
	help
	  This driver supports the Ethernet switch integrated in the
	  NXP LS1028A SoC.
```
